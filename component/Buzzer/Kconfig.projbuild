## component/Buzzer/Kconfig.projbuild
```kconfig
menu "z_____BUZZER CONFIG"
    config BUZZER_FREQ
        int "cai dat tan so am thanh 16HZ-20kHZ"
        default 5000
        help
            ...
endmenu
```

## component/MCP41010/Kconfig.projbuild
```kconfig
menu "z_____MCP41010 CONFIG"

    config SPI_FREQUENCY
        int "(HZ)set frequency of mcp41010"
        default 1000000
        help
            ...
endmenu
```

## main/Kconfig.projbuild
```kconfig
menu "z_____Pin out gpio,i2c,spi,1wire,... configuration"
    config POWER_PIN
        int "Pin cho nut bam 1 (power)"
        default 25
        help 
            cau hinh input pull up, khai bao interupt

    config MENU_PIN
        int "Pin cho nut bam 2 (menu)"
        default 26
        help 
            cau hinh intput pull up, khai bao interupt

    config SELECT_PIN
        int "Pin cho nut bam 3 (select)"
        default 27
        help 
            cau hinh input pull up, khai bao interupt

    config RELAY_PIN_1
        int "Pin cho relay 1 (ngat sac 1)"
        default 5
        help 
            cau hinh output
        
    config RELAY_PIN_2
        int "Pin cho relay 2 (ngat sac 2)"
        default 17
        help 
            cau hinh output
        
    config RELAY_NGUON
        int "Pin cho relay 3 (relay nguon)"
        default 16
        help 
            cau hinh output

    config BUZZER_PIN
        int "Pin cho buzzer"
        default 33
        help
            cau hinh output
    
    config SCK_PIN
        int "Pin xung clock SPI"
        default 14
        help
            ...

    config MOSI_PIN
        int "master out slave in SPI"
        default 13
        help 
            ...

    config MISO_PIN
        int "master in slave out SPI"
        default 12
        help 
            ...

    config CS_PIN_1
        int "Pin cho MCP41010 1"
        default 4
        help
            ...
            
    config CS_PIN_2
        int "Pin cho MCP41010 2"
        default 2
        help
            ...

    config CS_PIN_3
        int "Pin cho module micro sd"
        default 15
        help
            ...

    config DQ_PIN
        int "1 Wire bus data"
        default 23
        help 
            cau hinh pullup
    

    config 18B_ADDR1
        hex "18B20 adress pin 1 (HEX)"
        default 0x11111111
        help 
            ...
                    
    config 18B_ADDR2
        hex "18B20 adress pin 2 (HEX)"
        default 0x11111111
        help 
            ...

    config SCL_PIN
        int "SCL pin giao tiep i2c"
        default 22
        help
            cau hinh pullup

    config SDA_PIN
        int "SDA pin giao tiep i2c"
        default 21
        help
            cau hinh pullup

    config I2C_PORT
        int "I2C port Mac dinh 0 cho GPIO 21 va 22"
        default 0
        help
            ...

    config INA_ADDR1
        hex "dia chi INA219 so 1"
        default 0x40
        help 
            0x40 khi A0_GND A1_GND

    config INA_ADDR2
        hex "dia chi INA219 so 2"
        default 0x44
        help 
            0x44 khi A0_GND A1_3V3

    config MAX_CURRENT
        int "dong toi da INA219, mac dinh de 3A"
        default 3
        help 
            don vi ampe

    config SHUNT_RES
        int "dien tro shunt thuong co gia tri 100mOhm, khong duoc de 0"
        default 100
        help
            don vi mili ohm
    
    config LCD_ADDR
        hex "dia chi mac dinh LCD1602"
        default 0x27
        help 
            ......
    config LCD_COLS
        int "so cot lcd"
        default 16
        help 
            ......
    config LCD_ROWS
        int "so hang lcd"
        default 2
        help 
            ......

endmenu
```
